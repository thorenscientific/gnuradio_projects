// SPDX-License-Identifier: GPL-2.0
/dts-v1/;
/plugin/;

/ {
	compatible = "brcm,bcm2836", "brcm,bcm2835", "brcm,bcm2709";

	fragment@3 {
		target-path = "/";
		__overlay__ {
			one-bit-adc-dac@0 {
				compatible = "adi,one-bit-adc-dac";
				label = "gpios";
				#address-cells = <1>;
				#size-cells = <0>;
				in-gpios = <&gpio 22 0>;
				status = "okay";
				channel@0 {
					reg = <0>;
					label = "PTT";
				};
			};
		};
	};
};
